## firmware/bailout/src/modules/dh_bailout/Kconfig
```kconfig
menuconfig MODULES_DH_BAILOUT
	bool "dh_bailout"
	default n
	---help---
		DroneHacks "DH Bailout" flight mode: registers as an external mode,
		brakes to rest, then descends until PX4 detects the landing and disarms.
```

## firmware/bailout/src/modules/dh_fi_emulator/Kconfig
```kconfig
menuconfig MODULES_DH_FI_EMULATOR
	bool "dh_fi_emulator"
	default n
	depends on PLATFORM_POSIX
	---help---
		SITL test only: publishes trajectory_setpoint at 10 Hz like the kit's
		flight_interface, to test that DH Bailout keeps control.
```
